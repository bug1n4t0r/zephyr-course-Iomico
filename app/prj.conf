## CMakeLists.txt
```
cmake_minimum_required(VERSION 3.20.0)

cmake_path(GET CMAKE_CURRENT_SOURCE_DIR PARENT_PATH PROJECT_DIR)

list(APPEND BOARD_ROOT "${PROJECT_DIR}")

find_package(Zephyr REQUIRED)
project(my_zephyr_app)

target_sources(app PRIVATE src/main.cpp src/sensor_shell.c)
add_subdirectory("../driver_module/drivers/bugis_driver" 
                 "${CMAKE_CURRENT_BINARY_DIR}/bugis_driver")
```

## Kconfig
```
menuconfig LED_SUBSYSTEM
    bool "LED Subsystem"

# choice 
#     prompt "LED blink speed"
#     default BLINK_SLEEP_1000

# config BLINK_SLEEP_250
#     bool "250 ms (Fast)"    
# config BLINK_SLEEP_500
#     bool "500 ms (Semi-Fast)"    
# config BLINK_SLEEP_1000
#     bool "1 s (Normal)"    
# config BLINK_SLEEP_2000
#     bool "2 s (Slow)"    
# endchoice

# config BLINK_SLEEP_TIME_MS
#     int 
#     default 250 if BLINK_SLEEP_250
#     default 500 if BLINK_SLEEP_500
#     default 1000 if BLINK_SLEEP_1000
#     default 2000 if BLINK_SLEEP_2000
#     default 0

config  APP_HEARTBEAT_PERIOD_MS   
    int "Heartbeat Duration in ms"
    default 500
    range 100 2000

if LED_SUBSYSTEM

menuconfig ADVANCED_LED_SETTINGS
    bool "Advanced LED Settings"

config LED_BRIGHTNESS
    int "LED brightness (0-100)"
    default 100
    range 0 100

config LED_FADE
    int "LED fade duration (ms)"
    default 500
    range 0 5000    

menu "Expert Settings"
visible if ADVANCED_LED_SETTINGS

config LED_DEBUG
    bool "Enable LED debugging"

config CUSTOM_BLINK_PATTERN
    bool "Custom blink pattern"    
endmenu

endif

source "Kconfig.zephyr"
rsource "../driver_module/drivers/bugis_driver/Kconfig"
```

## prj.conf
```kconfig
CONFIG_SHELL=y
CONFIG_GPIO=y
CONFIG_GPIO_SHELL=y
CONFIG_LOG=y
```

## app.overlay
```dts
/{
    bugis_driver0: bugis_driver {
        compatible = "bugis,driver";
        status = "okay";
    };

    aliases {
        heartbeat-led = &green_led_2;
        btn= &user_button;
    };
};
```

## src/main.cpp
```c
#include <bugis_driver.h>
#include <zephyr/kernel.h>
#include <zephyr/logging/log.h>

LOG_MODULE_REGISTER(main, LOG_LEVEL_INF);

int main(void) {

  const struct device *driver = DEVICE_DT_GET(DT_NODELABEL(bugis_driver0));
  struct sensor_value  val;
  struct sensor_value *my_data = (struct sensor_value *)driver->data;
  uint8_t              zahl    = 0;

  while (1) {
    // bugis_set_val(driver, &zahl);
    // sensor_channel_get(driver, SENSOR_CHAN_AMBIENT_TEMP, &val);
    // k_msleep(CONFIG_APP_HEARTBEAT_PERIOD_MS);
    // sensor_sample_fetch(driver);
    // bugis_get_val(driver, &zahl);
    k_msleep(CONFIG_APP_HEARTBEAT_PERIOD_MS);
    // LOG_INF("%d", my_data->val);
    // zahl++;
  }
  return 0;
}
```

## src/sensor_shell.c
```c
#include <bugis_driver.h>
#include <stdlib.h>
#include <zephyr/device.h>
#include <zephyr/shell/shell.h>

static const struct device *sensor_dev =
    DEVICE_DT_GET(DT_NODELABEL(bugis_driver0));

static int cmd_fetch(const struct shell *sh, size_t argc, char **argv) {
  int ret = sensor_sample_fetch(sensor_dev);

  if (ret < 0) {
    shell_error(sh, "fetch failed: %d", ret);
  } else {
    shell_print(sh, "fetch ok");
  }
  return ret;
}

static int cmd_read(const struct shell *sh, size_t argc, char **argv) {
  struct sensor_value val;
  int ret = sensor_channel_get(sensor_dev, SENSOR_CHAN_AMBIENT_TEMP, &val);

  if (ret < 0) {
    shell_error(sh, "read failed: %d", ret);
  } else {
    shell_print(sh, "val: %d", val.val);
  }
  return ret;
}

static int cmd_info(const struct shell *sh, size_t argc, char **argv) {
  shell_print(sh, "name: %s", sensor_dev->name);
  shell_print(sh, "ready: %s", device_is_ready(sensor_dev) ? "yes" : "no");
  return 0;
}

static int cmd_set(const struct shell *sh, size_t argc, char **argv) {
  char *end;
  long  v = strtol(argv[1], &end, 10);

  if (*end != '\0' || v < 0 || v > UINT8_MAX) {
    shell_error(sh, "value must be 0-255");
    return -EINVAL;
  }

  uint8_t u8  = (uint8_t)v;
  int     ret = bugis_set_val(sensor_dev, &u8);

  uint8_t get;
  bugis_get_val(sensor_dev, &get);

  if (ret < 0) {
    shell_error(sh, "set failed: %d", ret);
  } else {
    shell_print(sh, "set ok: %d", get);
  }
  return ret;
}

SHELL_STATIC_SUBCMD_SET_CREATE(
    sensor_cmds, SHELL_CMD(fetch, NULL, "Call sensor_sample_fetch", cmd_fetch),
    SHELL_CMD(read, NULL, "Call sensor_channel_get and print result", cmd_read),
    SHELL_CMD(info, NULL, "Print device name and ready state", cmd_info),
    SHELL_CMD_ARG(set, NULL, "Call bugis_set_val <value> (0-255)", cmd_set, 2,
                  0),
    SHELL_SUBCMD_SET_END);

SHELL_CMD_REGISTER(sensor, &sensor_cmds, "Sensor shell commands", NULL);
```
