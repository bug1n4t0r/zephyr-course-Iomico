## boards/copy_board/Kconfig.copy_board
```kconfig
# Copyright (c) 2016 Matthias Boesl
# SPDX-License-Identifier: Apache-2.0

config BOARD_COPY_BOARD
	select SOC_STM32F411XE
```

## boards/copy_board/board.yml
```yaml
board:
  name: copy_board
  full_name: Nucleo F411RE Copy
  vendor: bugi
  socs:
    - name: stm32f411xe
```

## boards/scratch_board/board.yml
```yaml
board:
  name: scratch_board
  full_name: Scratch Clone for F411RE
  vendor: bugi
  socs:
    - name: stm32f411xe
```

## driver_module/dts/bindings/bugis,driver.yaml
```yaml
description: Bugis custom driver binding
compatible: "bugis,driver"
include: gpio.yaml
```
